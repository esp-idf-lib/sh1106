## examples/default/main/Kconfig.projbuild
```kconfig
menu "Example configuration"

    config EXAMPLE_I2C_SDA
        int "I2C SDA GPIO number"
        range 0 54
        default 6 if IDF_TARGET_ESP32C2 || IDF_TARGET_ESP32C3 || IDF_TARGET_ESP32C5 || IDF_TARGET_ESP32C6 || IDF_TARGET_ESP32C61
        default 5 if IDF_TARGET_ESP32H2
        default 3 if IDF_TARGET_ESP32P4
        default 21 if IDF_TARGET_ESP32 || IDF_TARGET_ESP32S2 || IDF_TARGET_ESP32S3
        default 21
        help
            GPIO number for the I2C data line.

    config EXAMPLE_I2C_SCL
        int "I2C SCL GPIO number"
        range 0 54
        default 5 if IDF_TARGET_ESP32C2 || IDF_TARGET_ESP32C3 || IDF_TARGET_ESP32C5 || IDF_TARGET_ESP32C6 || IDF_TARGET_ESP32C61
        default 4 if IDF_TARGET_ESP32H2
        default 2 if IDF_TARGET_ESP32P4
        default 22 if IDF_TARGET_ESP32 || IDF_TARGET_ESP32S2 || IDF_TARGET_ESP32S3
        default 22
        help
            GPIO number for the I2C clock line.

    config EXAMPLE_I2C_ADDR
        hex "I2C address"
        default 0x3C
        help
            I2C address of the module: 0x3C when the address pin is tied to
            ground, 0x3D when it is tied to the supply.

    config EXAMPLE_I2C_CLOCK_HZ
        int "I2C clock frequency"
        range 100000 1000000
        default 400000
        help
            I2C clock frequency in Hz.

    config EXAMPLE_RESET_GPIO
        int "Reset GPIO number"
        range -1 54
        default -1
        help
            GPIO number of the reset line of the module, -1 if the module has
            none.

endmenu
```
